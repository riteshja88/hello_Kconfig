## Kconfig
```kconfig
config FEATURE_A
      bool "Compile FEATURE_A"
      help
        Compile Feature A
		Use this to enabled Feature A in someapp.
		Not included by default

config FEATURE_B
      bool "Compile FEATURE_B"
      help
        Compile Feature B
		Use this to enabled Feature B in someapp.
		Not included by default

config FEATURE_C
      bool "Compile FEATURE_C"
      help
        Compile Feature C
		Use this to enabled Feature C in someapp.
		Not included by default


config FEATURE_D
      bool "Compile FEATURE_D"
      help
        Compile Feature D
		Use this to enabled Feature D in someapp.
		Not included by default

config FEATURE_E
      bool "Compile FEATURE_E"
      help
        Compile Feature E
		Use this to enabled Feature E in someapp.
		Not included by default
```

## lib1/Kconfig
```kconfig
config LIBSTATICOUTPUTFILE
	string "Output Static Library(.a) file name"
	default lib1.a
	help
		Output Static Library(.a) file name
		Use this to specify name of output static
		library file
	 
config FEATURE_1
	bool "Compile Feature 1"
	help
		Compile Feature 1
		Use this to enabled Feature 1 in lib1.
		Not included by default

config FEATURE_1_1
	bool "Compile Feature 1.1"
	depends on FEATURE_1
	help
		Compile Feature 1.1
		Use this to enabled Feature 1.1 in lib1.
		Not included by default

config FEATURE_1_2
	bool "Compile Feature 1.2"
	depends on FEATURE_1
	help
		Compile Feature 1.2
		Use this to enabled Feature 1.2 in lib1.
		Not included by default

config FEATURE_2
	bool "Compile Feature 2"
	help
		Compile Feature 2
		Use this to enabled Feature 2 in lib1.
		Not included by default

config FEATURE_2_1
	bool "Compile Feature 2.1"
	depends on FEATURE_2
	help
		Compile Feature 2.1
		Use this to enabled Feature 2.1 in lib1.
		Not included by default
```
